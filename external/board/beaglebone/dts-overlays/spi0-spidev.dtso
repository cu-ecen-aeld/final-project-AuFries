/dts-v1/;
/plugin/;

&spi1 {
    status = "okay";

    display@0 {
        compatible = "adafruit,yx240qv29", "ilitek,ili9341";
        reg = <0>;                       /* CS0 */
        spi-max-frequency = <32000000>;
        dc-gpios = <&gpio1 12 GPIO_ACTIVE_HIGH>;    /* pick your GPIO */
        reset-gpios = <&gpio1 13 GPIO_ACTIVE_HIGH>; /* pick your GPIO */
        rotation = <270>;                 /* optional */
        /* backlight = <&backlight>; */   /* optional */
    };
};