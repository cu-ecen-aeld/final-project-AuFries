/dts-v1/;
/plugin/;

/ {
  compatible = "ti,am335x-bone-black", "ti,am335x-bone", "ti,am33xx";

  fragment@0 {
    target-path = "/ocp/interconnect@48000000/segment@0/target-module@30000/spi@0";
    __overlay__ {
      status = "okay";

      #address-cells = <1>;
      #size-cells = <0>;

      spidev@0 {
        compatible = "rohm,dh2228fv"; // PLACEHOLDER COMPATIBLE FOR TESTING.
        reg = <0>;
        spi-max-frequency = <24000000>;
      };
    };
  };
};