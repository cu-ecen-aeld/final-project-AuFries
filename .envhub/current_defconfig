## external/Config.in
```kconfig
source "$BR2_EXTERNAL_ENVHUB_PATH/package/lvgl-graphics/Config.in"
source "$BR2_EXTERNAL_ENVHUB_PATH/package/envhub-app/Config.in"
```

## external/package/envhub-app/Config.in
```kconfig
config BR2_PACKAGE_ENVHUB_APP
	bool "envhub-app"
	select BR2_PACKAGE_LVGL_GRAPHICS
	select BR2_PACKAGE_LIBDRM
	help
	  Application processes for the envhub project
```

## external/package/lvgl-graphics/Config.in
```kconfig
config BR2_PACKAGE_LVGL_GRAPHICS
	bool "lvgl-graphics"
	select BR2_PACKAGE_LIBDRM
	help
	  Includes the LVGL graphics lib
```
